#include "WebUi.h"

#include <ArduinoJson.h>
#if defined(ARDUINO_ARCH_ESP8266)
#include <Updater.h>
#else
#include <Update.h>
#endif

#if defined(ARDUINO_ARCH_ESP32)
#include <esp_ota_ops.h>
#include <esp_partition.h>
#endif

#include "IndustrialApp.h"
#include "HomeKitBridge.h"

namespace industrial_v2 {

namespace {

bool gHttpOtaStarted = false;
String gHttpOtaErrorMessage;
static constexpr const char* kFsAppHtmlPath = "/webui/app.html";
static constexpr const char* kFsSetupHtmlPath = "/webui/setup.html";
static constexpr const char* kFsOtaHtmlPath = "/webui/ota.html";
static constexpr const char* kFsCustomProgramHtmlPath = "/webui/custom-program.html";

const uint8_t APP_HTML_GZ[] PROGMEM =
{
  0x1f, 0x8b, 0x08, 0x00, 0x00, 0x00, 0x00, 0x00, 0x02, 0xff, 0xe5, 0x7d, 0x7d, 0x7b, 0xdb, 0x38,
  0x92, 0xe7, 0xff, 0xf9, 0x14, 0x8c, 0xbb, 0x27, 0x14, 0xb7, 0x25, 0x59, 0x92, 0x9d, 0xc4, 0x2d,
  0x45, 0xf6, 0x39, 0x89, 0x33, 0xf1, 0x8d, 0x93, 0xf8, 0x6c, 0xa7, 0x7b, 0xe6, 0x72, 0xd9, 0x84,
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  0x7f, 0xb8, 0xf4, 0x8e, 0xe3, 0x00, 0x00,

};
static constexpr size_t APP_HTML_GZ_LEN = sizeof(APP_HTML_GZ);


const uint8_t OTA_HTML_GZ[] PROGMEM =
{
  0x1f, 0x8b, 0x08, 0x00, 0x00, 0x00, 0x00, 0x00, 0x02, 0xff, 0x95, 0x57, 0x6d, 0x73, 0xe3, 0xb6,
  0x11, 0xfe, 0xee, 0x5f, 0x81, 0x48, 0x73, 0x23, 0xa9, 0x21, 0x29, 0x52, 0x96, 0x75, 0x3a, 0x52,
  0xf2, 0x34, 0x69, 0x2f, 0x6d, 0x66, 0xd2, 0xa6, 0x13, 0x5f, 0xfb, 0xa5, 0xd3, 0x99, 0x03, 0x89,
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  0xb3, 0x69, 0x0e, 0x00, 0x00,

};
static constexpr size_t OTA_HTML_GZ_LEN = sizeof(OTA_HTML_GZ);


const uint8_t SETUP_HTML_GZ[] PROGMEM =
{
  0x1f, 0x8b, 0x08, 0x00, 0x00, 0x00, 0x00, 0x00, 0x02, 0xff, 0xad, 0x5a, 0xff, 0x77, 0x9b, 0x38,
  0x12, 0xff, 0xbd, 0x7f, 0x85, 0xea, 0xec, 0x2e, 0xe6, 0x0e, 0xb0, 0x71, 0x9d, 0xd4, 0x85, 0xe0,
  0x5e, 0x76, 0xdb, 0xdd, 0xf6, 0x6e, 0xdb, 0xe6, 0x9d, 0x73, 0x77, 0x3f, 0xec, 0xdb, 0xf7, 0x22,
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  0x00,

};
static constexpr size_t SETUP_HTML_GZ_LEN = sizeof(SETUP_HTML_GZ);

#if APP_ENABLE_MODBUS
const char MODBUS_MAP_HTML[] PROGMEM = R"rawliteral(<!doctype html>
<html lang="en">
<head>
<meta charset="utf-8">
<meta name="viewport" content="width=device-width,initial-scale=1">
<title>Modbus Map Editor</title>
<style>
:root{--bg:#09131c;--panel:#102433;--panel2:#0b1b26;--line:#2f6077;--ink:#edf5f8;--muted:#98b5c7;--ok:#8be08d;--err:#ff9b9b;--accent:#ff9f4d;--shadow:0 14px 32px rgba(0,0,0,.28)}
*{box-sizing:border-box}
body{margin:0;font-family:"Trebuchet MS","Gill Sans",sans-serif;background:radial-gradient(circle at top left,#1f4456 0,#09131c 48%),linear-gradient(150deg,#09131c,#153244 66%,#1d4255);color:var(--ink)}
.wrap{max-width:1100px;margin:0 auto;padding:20px}
h1{margin:0 0 6px;font-size:30px;letter-spacing:.04em}
.muted{color:var(--muted);margin:0 0 10px}
.panel{background:linear-gradient(180deg,rgba(255,255,255,.05),rgba(255,255,255,.02));border:1px solid rgba(255,255,255,.12);border-radius:16px;padding:14px;margin-bottom:14px;box-shadow:var(--shadow)}
.hidden{display:none}
.section-head{display:flex;justify-content:space-between;align-items:center;gap:10px;flex-wrap:wrap;margin-bottom:10px}
.section-head h3{margin:0;font-size:15px;letter-spacing:.08em;text-transform:uppercase;color:#dfeaf0}
.section-note{font-size:11px;color:var(--muted)}
.map-grid{display:grid;grid-template-columns:repeat(auto-fit,minmax(240px,1fr));gap:10px}
.map-card{background:var(--panel2);border:1px solid rgba(255,255,255,.09);border-radius:12px;padding:10px;display:grid;gap:8px}
.map-title{display:flex;align-items:center;justify-content:space-between;font-size:12px;color:#dce8ee;text-transform:uppercase;letter-spacing:.08em}
.chip{padding:4px 8px;border-radius:999px;background:#173243;border:1px solid rgba(255,255,255,.12);font-size:11px;color:#d5e8f1}
label{display:block;font-size:11px;color:var(--muted);letter-spacing:.06em;text-transform:uppercase}
input[type="number"]{width:100%;padding:10px 11px;border-radius:10px;border:1px solid var(--line);background:#0a151d;color:var(--ink);min-height:40px}
.word-toggle{display:flex;align-items:center;justify-content:space-between;gap:10px;padding:8px 10px;border:1px solid var(--line);border-radius:10px;background:#0a151d}
.word-toggle span{font-size:12px;color:#d7e7ef}
.word-toggle small{display:block;color:var(--muted);font-size:10px}
.switch{position:relative;width:42px;height:24px;display:inline-block;flex:0 0 auto}
.switch input{opacity:0;width:0;height:0;position:absolute}
.slider{position:absolute;inset:0;background:#2c4553;border-radius:999px;border:1px solid rgba(255,255,255,.18);transition:all .2s ease}
.slider:before{content:"";position:absolute;width:18px;height:18px;left:2px;top:2px;border-radius:50%;background:#dbe7ed;transition:all .2s ease}
.switch input:checked+.slider{background:linear-gradient(135deg,#0f9f88,#14c7aa)}
.switch input:checked+.slider:before{transform:translateX(18px);background:#ffffff}
.actions{display:flex;flex-wrap:wrap;gap:10px;margin-top:12px}
button,a{padding:10px 14px;border-radius:10px;border:1px solid var(--line);background:#0a151d;color:var(--ink);text-decoration:none;cursor:pointer;min-height:42px}
button.primary{background:linear-gradient(135deg,var(--accent),#ffc178);color:#26160a;border:none;font-weight:700}
#status{margin-top:10px;padding:10px;border-radius:10px;background:#0a151d;border:1px solid var(--line);white-space:pre-wrap}
.ok{color:var(--ok)}
.err{color:var(--err)}
@media (max-width:760px){.wrap{padding:12px}.actions{flex-direction:column}.actions button,.actions a{width:100%}}
</style>
</head>
<body>
<div class="wrap">
  <h1>Modbus Map Editor</h1>
  <p class="muted">Editor responsive para direccion y formato por canal (1 o 2 registros).</p>
  <p class="muted" id="mode-note">Modo actual: --</p>

  <div class="panel" id="panel-publish">
    <div class="section-head">
      <h3>Temperatura (publicacion)</h3>
      <div class="section-note">Direcciones usadas para publicar en local/cloud.</div>
    </div>
    <div class="map-grid" id="temp-grid"></div>
    <div class="section-head" style="margin-top:12px">
      <h3>Humedad (publicacion)</h3>
      <div class="section-note">Configura H1-H2 segun tus registros remotos.</div>
    </div>
    <div class="map-grid" id="hum-grid"></div>
  </div>

  <div class="panel" id="panel-hybrid-source">
    <div class="section-head">
      <h3>Temperatura (mirror/hybrid source)</h3>
      <div class="section-note">Origen remoto usado por modo Hybrid.</div>
    </div>
    <div class="map-grid" id="temp-mirror-grid"></div>
    <div class="section-head" style="margin-top:12px">
      <h3>Humedad (mirror/hybrid source)</h3>
      <div class="section-note">Mirror source para H1-H2.</div>
    </div>
    <div class="map-grid" id="hum-mirror-grid"></div>
  </div>

  <div class="actions">
    <button class="primary" id="save">Guardar mapeo</button>
    <button id="reload">Recargar</button>
    <a href="/app">Volver a /app</a>
  </div>

  <div id="status">Cargando...</div>
</div>

<script>
const SPECS=[
  {key:'modbusTempRegisters',wordsKey:'modbusTempRegisterWords',count:4,prefix:'T',host:'temp-grid'},
  {key:'modbusHumRegisters',wordsKey:'modbusHumRegisterWords',count:2,prefix:'H',host:'hum-grid'},
  {key:'modbusMirrorTempRegisters',wordsKey:'modbusMirrorTempRegisterWords',count:4,prefix:'T',host:'temp-mirror-grid'},
  {key:'modbusMirrorHumRegisters',wordsKey:'modbusMirrorHumRegisterWords',count:2,prefix:'H',host:'hum-mirror-grid'}
];

let cfg={};
function el(id){return document.getElementById(id)}
function setStatus(text,kind){const n=el('status');n.textContent=text;n.className=kind||''}
function toInt(v,fallback=0){const n=Number(v);return Number.isFinite(n)?Math.trunc(n):fallback}
function clamp(v,min,max){return Math.max(min,Math.min(max,v))}

function modbusModeLabel(mode){
  if(mode===3)return 'TCP to RTU';
  if(mode===4)return 'Slave to Me';
  if(mode===5)return 'Slave to Me Hybrid TCP';
  if(mode===1)return 'RTU Server';
  if(mode===2)return 'TCP Server';
  return 'Off';
}

function applyModeVisibility(){
  const mode=toInt(cfg.modbusMode,0);
  const publishPanel=el('panel-publish');
  const hybridPanel=el('panel-hybrid-source');
  const modeNote=el('mode-note');
  if(modeNote){
    modeNote.textContent=`Modo actual: ${modbusModeLabel(mode)} (mode=${mode})`;
  }

  const isTcpRtu=mode===3;
  const isSlaveToMe=mode===4;
  const isHybrid=mode===5;

  if(publishPanel){
    publishPanel.classList.toggle('hidden',!(isTcpRtu||isSlaveToMe||isHybrid));
  }
  if(hybridPanel){
    hybridPanel.classList.toggle('hidden',!isHybrid);
  }

  if(modeNote){
    if(isHybrid){
      modeNote.textContent+=' | En Hybrid, el origen remoto usa bloques mirror/hybrid source.';
    }else if(isTcpRtu||isSlaveToMe){
      modeNote.textContent+=' | En este modo, el origen remoto usa bloques de publicacion.';
    }else{
      modeNote.textContent+=' | Este editor aplica principalmente a TCP-RTU (3), Slave to Me (4) y Hybrid (5).';
    }
  }
}

function renderCard(spec,index,addrValue,twoRegs){
  const card=document.createElement('div');
  card.className='map-card';

  const title=document.createElement('div');
  title.className='map-title';
  title.innerHTML=`<span>Canal ${spec.prefix}${index+1}</span><span class="chip">${spec.prefix}${index+1}</span>`;

  const addrWrap=document.createElement('div');
  const addrLabel=document.createElement('label');
  addrLabel.textContent='Direccion Modbus';
  const addr=document.createElement('input');
  addr.id=`${spec.key}-${index}-addr`;
  addr.type='number';
  addr.step='1';
  addr.min='0';
  addr.max='65535';
  addr.value=clamp(toInt(addrValue,0),0,65535);
  addrWrap.append(addrLabel,addr);

  const toggle=document.createElement('label');
  toggle.className='word-toggle';
  const text=document.createElement('span');
  text.innerHTML='2 registros (32-bit)<small>Activa para int32/float en 2 words</small>';
  const switchWrap=document.createElement('span');
  switchWrap.className='switch';
  const chk=document.createElement('input');
  chk.id=`${spec.key}-${index}-w2`;
  chk.type='checkbox';
  chk.checked=Boolean(twoRegs);
  const slider=document.createElement('span');
  slider.className='slider';
  switchWrap.append(chk,slider);
  toggle.append(text,switchWrap);

  card.append(title,addrWrap,toggle);
  return card;
}

function render(){
  SPECS.forEach(spec=>{
    const host=el(spec.host);
    host.innerHTML='';
    const regs=Array.isArray(cfg[spec.key])?cfg[spec.key]:[];
    const words=Array.isArray(cfg[spec.wordsKey])?cfg[spec.wordsKey]:[];
    for(let i=0;i<spec.count;i++){
      const addr=regs[i]??0;
      const twoRegs=toInt(words[i]??1,1)>1;
      host.appendChild(renderCard(spec,i,addr,twoRegs));
    }
  });
  applyModeVisibility();
}

function collectPayload(){
  const payload={};
  SPECS.forEach(spec=>{
    const regs=[];
    const words=[];
    for(let i=0;i<spec.count;i++){
      const addrNode=el(`${spec.key}-${i}-addr`);
      const twoRegsNode=el(`${spec.key}-${i}-w2`);
      regs.push(clamp(toInt(addrNode?addrNode.value:0,0),0,65535));
      words.push(twoRegsNode&&twoRegsNode.checked?2:1);
    }
    payload[spec.key]=regs;
    payload[spec.wordsKey]=words;
  });
  return payload;
}

async function loadConfig(){
  const res=await fetch('/api/v1/config',{cache:'no-store'});
  if(!res.ok)throw new Error(await res.text()||res.statusText);
  cfg=await res.json();
  render();
  setStatus('Configuracion cargada.','ok');
}

async function save(){
  try{
    const payload=collectPayload();
    const res=await fetch('/api/v1/config',{method:'POST',headers:{'Content-Type':'application/json'},body:JSON.stringify(payload)});
    if(!res.ok)throw new Error(await res.text()||res.statusText);
    await loadConfig();
    setStatus('Mapeo guardado correctamente.','ok');
  }catch(error){
    setStatus('Error guardando: '+error.message,'err');
  }
}

el('save').onclick=()=>{void save()};
el('reload').onclick=()=>{void loadConfig()};
void loadConfig().catch(error=>setStatus('Error cargando: '+error.message,'err'));
</script>
</body>
</html>
)rawliteral";
#endif

const char CUSTOM_PROGRAM_HTML[] PROGMEM = R"rawliteral(
<!doctype html>
<html lang="es">
<head>
<meta charset="utf-8">
<meta name="viewport" content="width=device-width,initial-scale=1">
<title>Custom WorkMode Program</title>
<style>
:root{--bg:#0d1822;--panel:#152738;--line:#32556f;--ink:#eef4f7;--muted:#9db4c2;--ok:#8be08d;--err:#ff9b9b;--warn:#ffd67a;--accent:#5ec7ff}
*{box-sizing:border-box}
body{margin:0;font-family:"Trebuchet MS","Gill Sans",sans-serif;background:linear-gradient(150deg,#08121a,#102331 58%,#193648);color:var(--ink)}
.wrap{max-width:1100px;margin:0 auto;padding:20px}
h1{margin:0 0 6px;font-size:28px}
.muted{color:var(--muted);margin:0 0 16px}
.panel{background:rgba(255,255,255,.03);border:1px solid rgba(255,255,255,.12);border-radius:14px;padding:14px;margin-bottom:14px}
.grid{display:grid;grid-template-columns:repeat(auto-fit,minmax(220px,1fr));gap:10px}
label{display:block;font-size:12px;color:var(--muted);margin-bottom:6px}
select,textarea{width:100%;padding:10px;border-radius:10px;border:1px solid var(--line);background:#0a151d;color:var(--ink)}
textarea{min-height:340px;font-family:Consolas,"Courier New",monospace;resize:vertical;line-height:1.35}
.actions{display:flex;flex-wrap:wrap;gap:10px;margin-top:12px}
button,a{padding:10px 14px;border-radius:10px;border:1px solid var(--line);background:#0a151d;color:var(--ink);text-decoration:none;cursor:pointer}
button.primary{background:linear-gradient(135deg,var(--accent),#a9ecff);color:#072432;border:none;font-weight:700}
#status{margin-top:10px;padding:10px;border-radius:10px;background:#0a151d;border:1px solid var(--line);white-space:pre-wrap}
.ok{color:var(--ok)}
.err{color:var(--err)}
.warn{color:var(--warn)}
.hint{font-size:12px;color:var(--muted);line-height:1.5}
.docs{display:grid;grid-template-columns:repeat(auto-fit,minmax(260px,1fr));gap:10px}
.doc{background:#0a151d;border:1px solid var(--line);border-radius:10px;padding:10px}
.doc h3{margin:0 0 8px;font-size:14px}
.doc ul{margin:0;padding-left:18px}
.doc li{margin:4px 0;color:var(--muted);font-size:12px;line-height:1.45}
.mono{font-family:Consolas,"Courier New",monospace;color:var(--ink)}
.code{display:block;margin-top:8px;padding:8px;border-radius:8px;background:#081019;border:1px solid #27455d;white-space:pre-wrap;font-family:Consolas,"Courier New",monospace;font-size:12px;color:#d8ecf7}
@media (max-width:700px){.wrap{padding:12px}.actions{flex-direction:column}.actions button,.actions a{width:100%}}
</style>
</head>
<body>
<div class="wrap">
  <h1>Programa Custom (WORK_CUSTOM)</h1>
  <p class="muted">Editor seguro de reglas online para relays. El parser valida sintaxis y ejecuta en ciclos no bloqueantes.</p>

  <div class="panel">
    <div class="grid">
      <div>
        <label for="workMode">Modo de trabajo</label>
        <select id="workMode">
          <option value="0">Desactivado</option>
          <option value="1">Termostato</option>
          <option value="2">Pushbutton</option>
          <option value="3">Manual</option>
          <option value="4">Custom</option>
        </select>
      </div>
      <div>
        <label>Estado compilacion</label>
        <div id="compile-status" class="hint">--</div>
      </div>
    </div>
    <div class="actions">
      <button class="primary" id="save">Guardar programa</button>
      <button id="reload">Recargar</button>
      <button id="template-blink">Plantilla Blink</button>
      <button id="template-pasteurizer">Plantilla Pasteurizador</button>
      <button id="template-wash">Plantilla Lavado</button>
      <a href="/app">Volver a /app</a>
    </div>
  </div>

  <div class="panel">
    <label for="program">Programa custom</label>
    <textarea id="program" spellcheck="false"></textarea>
    <p class="hint">
Comandos validos:
SET RELn ON|OFF
BLINK RELn onMs [offMs]
TIMER RELn onMs offMs
ONCHANGE INn TOGGLE RELm
PULSE INn RELm onMs count [gapMs]
THERMOSTAT RELn TEMPm setpoint diff [AUTO|COOL|HEAT]
IF TEMPn op valor THEN RELm ON|OFF
IF HUMn op valor THEN RELm ON|OFF
IF INn op ON|OFF THEN RELm ON|OFF
IFALL src1 op v1 src2 op v2 THEN RELm ON|OFF
IFANY src1 op v1 src2 op v2 THEN RELm ON|OFF
Operadores: == != > >= < <=
    </p>
  </div>

  <div class="panel">
    <h2 style="margin:0 0 10px">Referencia completa</h2>
    <div class="docs">
      <div class="doc">
        <h3>Campos del script</h3>
        <ul>
          <li><span class="mono">REL1..REL4</span>: salidas (reles) que puedes activar.</li>
          <li><span class="mono">IN1..IN4</span>: entradas digitales.</li>
          <li><span class="mono">TEMP1..TEMP4</span>: sondas de temperatura.</li>
          <li><span class="mono">HUM1..HUM2</span>: sondas de humedad.</li>
          <li>Maximo de reglas: <span class="mono">24</span>.</li>
        </ul>
      </div>

      <div class="doc">
        <h3>Sintaxis disponible</h3>
        <ul>
          <li><span class="mono">SET RELn ON|OFF</span></li>
          <li><span class="mono">BLINK RELn onMs [offMs]</span> (50..3600000 ms)</li>
          <li><span class="mono">TIMER RELn onMs offMs</span> (50..3600000 ms)</li>
          <li><span class="mono">ONCHANGE INn TOGGLE RELm</span></li>
          <li><span class="mono">PULSE INn RELm onMs count [gapMs]</span> (count 1..20)</li>
          <li><span class="mono">THERMOSTAT RELn TEMPm setpoint diff [AUTO|COOL|HEAT]</span></li>
          <li><span class="mono">IF TEMPn op valor THEN RELm ON|OFF</span></li>
          <li><span class="mono">IF HUMn op valor THEN RELm ON|OFF</span></li>
          <li><span class="mono">IF INn op ON|OFF THEN RELm ON|OFF</span></li>
          <li><span class="mono">IFALL src1 op v1 src2 op v2 THEN RELm ON|OFF</span></li>
          <li><span class="mono">IFANY src1 op v1 src2 op v2 THEN RELm ON|OFF</span></li>
        </ul>
      </div>

      <div class="doc">
        <h3>Condiciones y matematica</h3>
        <ul>
          <li>Comparadores: <span class="mono">== != &gt; &gt;= &lt; &lt;=</span></li>
          <li>Soporta histeresis con <span class="mono">THERMOSTAT</span> usando <span class="mono">setpoint</span> y <span class="mono">diff</span>.</li>
          <li>Soporta compuertas logicas de 2 condiciones con <span class="mono">IFALL</span> (AND) y <span class="mono">IFANY</span> (OR).</li>
          <li>No soporta expresiones libres: <span class="mono">+ - * / () ELSE</span>.</li>
          <li>Comentarios: linea con <span class="mono">//</span> o inline con <span class="mono">#</span>.</li>
        </ul>
      </div>

      <div class="doc">
        <h3>API local para actuar</h3>
        <ul>
          <li><span class="mono">GET /api/v1/config</span></li>
          <li><span class="mono">POST /api/v1/config</span> para guardar config completa.</li>
          <li><span class="mono">POST /api/v1/control</span> para cambios rapidos de control.</li>
          <li><span class="mono">GET /api/v1/state</span> para validacion del parser.</li>
          <li>Estado parser: <span class="mono">customProgramValid</span>, <span class="mono">customProgramRuleCount</span>, <span class="mono">customProgramError</span>.</li>
        </ul>
      </div>

      <div class="doc">
        <h3>Campos clave (control local)</h3>
        <ul>
          <li><span class="mono">workMode</span> (0..4)</li>
          <li><span class="mono">customProgram</span> (texto del programa)</li>
          <li><span class="mono">setpoint</span>, <span class="mono">setpoint2</span></li>
          <li><span class="mono">manualRelays</span> (array bool)</li>
          <li><span class="mono">relay1..relay4</span> (bool)</li>
        </ul>
      </div>

      <div class="doc">
        <h3>Campos cloud desiredState</h3>
        <ul>
          <li><span class="mono">workMode</span>, <span class="mono">customProgram</span>, <span class="mono">power</span>, <span class="mono">mode</span>, <span class="mono">fan</span></li>
          <li><span class="mono">setpoint</span>, <span class="mono">setpoint2</span>, <span class="mono">differentialX10</span></li>
          <li><span class="mono">highAlarmX10</span>, <span class="mono">lowAlarmX10</span>, <span class="mono">tempAlarmDelayMin</span></li>
          <li><span class="mono">controlPeriodMs</span>, <span class="mono">defrostIntervalMin</span>, <span class="mono">defrostDurationMin</span>, <span class="mono">defrostStopX10</span></li>
          <li><span class="mono">stopRelay1OnDefrost</span>, <span class="mono">stopRelay2OnDefrost</span>, <span class="mono">relay2Mode</span>, <span class="mono">relay3Mode</span></li>
          <li><span class="mono">relays</span> objeto: <span class="mono">{"REL1":true,"REL2":false,...}</span></li>
        </ul>
      </div>
    </div>

    <span class="code">Ejemplo POST /api/v1/config
{
  "workMode": 4,
  "customProgram": "THERMOSTAT REL1 TEMP1 4.0 0.8 COOL\nIFALL TEMP1 &gt; 30 HUM1 &gt; 70 THEN REL2 ON\nIFANY IN1 == ON IN2 == ON THEN REL2 OFF\nONCHANGE IN3 TOGGLE REL3\nPULSE IN4 REL4 2000 2 300\nTIMER REL2 5000 3000"
}</span>
  </div>

  <div id="status">Cargando...</div>
</div>

<script>
let cfg={};
let state={};

function el(id){return document.getElementById(id)}
function setStatus(text,kind){const n=el('status');n.textContent=text;n.className=kind||''}
function toInt(v,fallback=0){const n=Number(v);return Number.isFinite(n)?Math.trunc(n):fallback}

const templates={
  blink:[
    '# Blink simple',
    'BLINK REL1 500 500',
    'SET REL2 OFF',
    'SET REL3 OFF',
    'SET REL4 OFF'
  ].join('\n'),
  pasteurizer:[
    '# Pasteurizador basico',
    '# REL1: resistencia',
    '# REL2: bomba recirculacion',
    '# REL3: alarma alta',
    'THERMOSTAT REL1 TEMP1 72 1 HEAT',
    'SET REL2 ON',
    'IF TEMP1 >= 78 THEN REL3 ON',
    'IF TEMP1 <= 76 THEN REL3 OFF'
  ].join('\n'),
  wash:[
    '# Lavado CIP simple',
    '# REL1 bomba ciclica',
    '# REL2 valvula enjuague',
    'BLINK REL1 12000 8000',
    'IF TEMP1 >= 45 THEN REL2 ON',
    'IF TEMP1 <= 42 THEN REL2 OFF',
    'SET REL3 OFF',
    'SET REL4 OFF'
  ].join('\n')
};

function render(){
  el('workMode').value=String(toInt(cfg.workMode,1));
  el('program').value=typeof cfg.customProgram==='string'?cfg.customProgram:'';
  const valid=Boolean(state.customProgramValid);
  const count=toInt(state.customProgramRuleCount,0);
  const error=state.customProgramError||'';
  const node=el('compile-status');
  if(valid){
    node.textContent='Valido ('+count+' reglas)';
    node.className='hint ok';
  }else if(error){
    node.textContent='Invalido: '+error;
    node.className='hint err';
  }else{
    node.textContent='Sin compilar';
    node.className='hint warn';
  }
}

async function loadAll(){
  const [cfgRes,stateRes]=await Promise.all([
    fetch('/api/v1/config',{cache:'no-store'}),
    fetch('/api/v1/state',{cache:'no-store'})
  ]);
  if(!cfgRes.ok)throw new Error(await cfgRes.text()||cfgRes.statusText);
  if(!stateRes.ok)throw new Error(await stateRes.text()||stateRes.statusText);
  cfg=await cfgRes.json();
  state=await stateRes.json();
  render();
  setStatus('Configuracion custom cargada.', 'ok');
}

async function saveProgram(){
  try{
    const payload={
      workMode:toInt(el('workMode').value,1),
      customProgram:el('program').value
    };
    const res=await fetch('/api/v1/config',{
      method:'POST',
      headers:{'Content-Type':'application/json'},
      body:JSON.stringify(payload)
    });
    if(!res.ok)throw new Error(await res.text()||res.statusText);
    await loadAll();
    if(state.customProgramValid){
      setStatus('Programa guardado y validado. Modo actual: '+toInt(cfg.workMode,1), 'ok');
    }else{
      setStatus('Programa guardado pero invalido: '+(state.customProgramError||'sin detalle'), 'warn');
    }
  }catch(error){
    setStatus('Error guardando: '+error.message, 'err');
  }
}

el('save').onclick=()=>{void saveProgram()};
el('reload').onclick=()=>{void loadAll()};
el('template-blink').onclick=()=>{el('program').value=templates.blink};
el('template-pasteurizer').onclick=()=>{el('program').value=templates.pasteurizer};
el('template-wash').onclick=()=>{el('program').value=templates.wash};
void loadAll().catch(error=>setStatus('Error cargando: '+error.message, 'err'));
</script>
</body>
</html>
)rawliteral";


void sendJsonStatus(int code, bool ok, const String& message) {
  StaticJsonDocument<256> doc;
  doc["ok"] = ok;
  doc["message"] = message;
  String out;
  serializeJson(doc, out);
  server.sendHeader("Cache-Control", "no-store");
  server.send(code, "application/json", out);
}

bool setupAccessAllowed() {
  return !hasStoredConfig() || runtimeData.apModeActive || !config().wifiSsid[0];
}

String buildNetworkJson() {
  StaticJsonDocument<1024> doc;
  doc["hostName"] = config().hostName;
  doc["adminUser"] = config().adminUser;
  doc["adminPass"] = config().adminPass;
  doc["wifiSsid"] = config().wifiSsid;
  doc["wifiPass"] = config().wifiPass;
  doc["apPassword"] = config().apPassword;
  doc["otaPassword"] = config().otaPassword;
  doc["wifiUseDhcp"] = config().wifiUseDhcp;
  doc["wifiStaticIp"] = config().wifiStaticIp;
  doc["wifiSubnetMask"] = config().wifiSubnetMask;
  doc["wifiGateway"] = config().wifiGateway;
  doc["wifiDns1"] = config().wifiDns1;
  doc["wifiDns2"] = config().wifiDns2;
  doc["wifiConnectTimeoutSec"] = config().wifiConnectTimeoutSec;
  doc["keepApEnabled"] = config().keepApEnabled;
  doc["enableOta"] = config().enableOta;
  doc["wifiConnected"] = runtimeData.wifiConnected;
  doc["apModeActive"] = runtimeData.apModeActive;
  doc["ipAddress"] = runtimeData.ipAddress;
  doc["connectedSsid"] = runtimeData.connectedSsid;
  doc["apSsid"] = runtimeData.apSsid;
  String out;
  serializeJson(doc, out);
  return out;
}

String buildWifiScanJson() {
  StaticJsonDocument<2048> doc;
  JsonArray networks = doc.createNestedArray("networks");
  const int found = WiFi.scanNetworks();
  for (int index = 0; index < found && index < 20; ++index) {
    JsonObject row = networks.createNestedObject();
    row["ssid"] = WiFi.SSID(index);
    row["rssi"] = WiFi.RSSI(index);
  }
  WiFi.scanDelete();
  String out;
  serializeJson(doc, out);
  return out;
}

class StringPrint : public Print {
 public:
  size_t write(uint8_t ch) override {
    buffer += static_cast<char>(ch);
    return 1;
  }

  size_t write(const uint8_t* data, size_t size) override {
    if (!data || !size) return 0;
    for (size_t index = 0; index < size; ++index) {
      buffer += static_cast<char>(data[index]);
    }
    return size;
  }

  String buffer;
};

#if defined(ARDUINO_ARCH_ESP32)
size_t countOtaAppPartitions() {
  size_t count = 0;
  for (esp_partition_iterator_t it = esp_partition_find(ESP_PARTITION_TYPE_APP, ESP_PARTITION_SUBTYPE_ANY, nullptr); it != nullptr; it = esp_partition_next(it)) {
    const esp_partition_t* partition = esp_partition_get(it);
    if (!partition) continue;
    if (partition->subtype >= ESP_PARTITION_SUBTYPE_APP_OTA_0 && partition->subtype < ESP_PARTITION_SUBTYPE_APP_OTA_MAX) ++count;
  }
  return count;
}

String httpOtaPreflightError(size_t firmwareSize) {
  const size_t otaPartitionCount = countOtaAppPartitions();
  if (otaPartitionCount < 2) {
    return "OTA unavailable: no free OTA slot. Flash by USB.";
  }
  const esp_partition_t* running = esp_ota_get_running_partition();
  const esp_partition_t* target = esp_ota_get_next_update_partition(nullptr);
  if (!target || (running && target->address == running->address)) {
    return "OTA unavailable: target slot error. Flash by USB.";
  }
  if (firmwareSize && firmwareSize > target->size) {
    String message = "OTA image too large for slot: ";
    message += static_cast<unsigned long>(firmwareSize);
    message += " > ";
    message += static_cast<unsigned long>(target->size);
    message += " bytes.";
    return message;
  }
  return String();
}
#else
String httpOtaPreflightError(size_t firmwareSize) {
  (void)firmwareSize;
  return String();
}
#endif

size_t otaUploadBeginSize(size_t uploadSize) {
  if (uploadSize) return uploadSize;
#if defined(ARDUINO_ARCH_ESP8266)
  return static_cast<size_t>((ESP.getFreeSketchSpace() - 0x1000U) & 0xFFFFF000U);
#else
  return static_cast<size_t>(-1);
#endif
}

void cancelOtaUpload() {
  // Works on both ESP8266 and ESP32 to close the current OTA session.
  Update.end();
}

void clearHttpOtaState() {
  gHttpOtaStarted = false;
  gHttpOtaErrorMessage = String();
}

String otaUploadResultText() {
  if (gHttpOtaErrorMessage.length()) return gHttpOtaErrorMessage;
  StringPrint errors;
  Update.printError(errors);
  String message = errors.buffer;
  message.trim();
  if (!message.length()) message = "OTA upload failed";
  return message;
}

void sendCompressedHtml(const uint8_t* data, size_t length) {
  server.sendHeader("Content-Encoding", "gzip");
  server.send_P(200, "text/html", reinterpret_cast<PGM_P>(data), length);
}

bool sendHtmlFromFilesystem(const char* htmlPath) {
  if (!htmlPath || !htmlPath[0]) return false;

  File htmlFile = APP_FILESYSTEM.open(htmlPath, "r");
  if (htmlFile) {
    const size_t htmlSize = static_cast<size_t>(htmlFile.size());
    if (htmlSize < 32U) {
      htmlFile.close();
      return false;
    }
    server.streamFile(htmlFile, "text/html");
    htmlFile.close();
    return true;
  }

  const String gzPath = String(htmlPath) + String(".gz");
  File gzFile = APP_FILESYSTEM.open(gzPath, "r");
  if (!gzFile) return false;
  const size_t gzSize = static_cast<size_t>(gzFile.size());
  if (gzSize < 32U) {
    gzFile.close();
    return false;
  }

  server.sendHeader("Content-Encoding", "gzip");
  server.streamFile(gzFile, "text/html");
  gzFile.close();
  return true;
}

}  // namespace

void registerWebRoutes() {
  server.on("/", HTTP_GET, []() {
    server.sendHeader("Cache-Control", "no-store");
    server.sendHeader("Location", setupAccessAllowed() ? "/setup" : "/app");
    server.send(302, "text/plain", "redirect");
  });

  server.on("/setup", HTTP_GET, []() {
    if (!setupAccessAllowed() && !ensureAdminAuthenticated()) return;
    server.sendHeader("Cache-Control", "no-store");
    if (!sendHtmlFromFilesystem(kFsSetupHtmlPath)) {
      sendCompressedHtml(SETUP_HTML_GZ, SETUP_HTML_GZ_LEN);
    }
  });

  server.on("/app", HTTP_GET, []() {
    if (!ensureAdminAuthenticated()) return;
    server.sendHeader("Cache-Control", "no-store");
    if (server.hasArg("page")) {
      const String page = server.arg("page");
      if (page == "custom-program") {
        if (!sendHtmlFromFilesystem(kFsCustomProgramHtmlPath)) {
          server.send_P(200, "text/html", reinterpret_cast<PGM_P>(CUSTOM_PROGRAM_HTML));
        }
        return;
      }
    }
    if (!sendHtmlFromFilesystem(kFsAppHtmlPath)) {
      sendCompressedHtml(APP_HTML_GZ, APP_HTML_GZ_LEN);
    }
  });

  server.on("/custom-program", HTTP_GET, []() {
    if (!ensureAdminAuthenticated()) return;
    server.sendHeader("Cache-Control", "no-store");
    if (!sendHtmlFromFilesystem(kFsCustomProgramHtmlPath)) {
      server.send_P(200, "text/html", reinterpret_cast<PGM_P>(CUSTOM_PROGRAM_HTML));
    }
  });

  server.on("/ota", HTTP_GET, []() {
    if (!ensureAdminAuthenticated()) return;
    server.sendHeader("Cache-Control", "no-store");
    if (!sendHtmlFromFilesystem(kFsOtaHtmlPath)) {
      sendCompressedHtml(OTA_HTML_GZ, OTA_HTML_GZ_LEN);
    }
  });

  server.on("/api/v1/network", HTTP_GET, []() {
    if (!setupAccessAllowed() && !ensureAdminAuthenticated()) return;
    server.sendHeader("Cache-Control", "no-store");
    server.send(200, "application/json", buildNetworkJson());
  });

  server.on("/api/v1/network", HTTP_POST, []() {
    if (!setupAccessAllowed() && !ensureAdminAuthenticated()) return;
    String error;
    if (updateNetworkFromJson(server.arg("plain"), error)) sendJsonStatus(200, true, "network saved");
    else sendJsonStatus(400, false, error);
  });

  server.on("/api/v1/wifi-scan", HTTP_GET, []() {
    if (!setupAccessAllowed() && !ensureAdminAuthenticated()) return;
    server.sendHeader("Cache-Control", "no-store");
    server.send(200, "application/json", buildWifiScanJson());
  });

  server.on("/api/v1/ota", HTTP_POST, []() {
    if (!ensureAdminAuthenticated()) return;
    const bool success = gHttpOtaStarted && !Update.hasError() && !gHttpOtaErrorMessage.length();
    const String message = success ? String("OTA uploaded successfully. Reboot scheduled.") : otaUploadResultText();
    server.sendHeader("Cache-Control", "no-store");
    server.send(success ? 200 : 500, "text/plain", message);
    if (success) {
      addLog("HTTP OTA upload completed successfully");
      scheduleRestart("http ota", 1500U);
    } else {
      addLog("HTTP OTA upload failed: %s", message.c_str());
    }
    clearHttpOtaState();
  }, []() {
    HTTPUpload& upload = server.upload();
    switch (upload.status) {
      case UPLOAD_FILE_START:
        clearHttpOtaState();
        addLog("HTTP OTA upload started: %s", upload.filename.c_str());
        gHttpOtaErrorMessage = httpOtaPreflightError(upload.totalSize);
        if (gHttpOtaErrorMessage.length()) {
          addLog("HTTP OTA upload rejected: %s", gHttpOtaErrorMessage.c_str());
          break;
        }
        if (!Update.begin(otaUploadBeginSize(upload.totalSize), U_FLASH)) {
          Update.printError(Serial);
          gHttpOtaErrorMessage = otaUploadResultText();
          addLog("HTTP OTA begin failed: %s", gHttpOtaErrorMessage.c_str());
        } else {
          gHttpOtaStarted = true;
        }
        break;
      case UPLOAD_FILE_WRITE:
        if (!gHttpOtaStarted) break;
        if (Update.write(upload.buf, upload.currentSize) != upload.currentSize) {
          Update.printError(Serial);
          gHttpOtaErrorMessage = otaUploadResultText();
          addLog("HTTP OTA write failed: %s", gHttpOtaErrorMessage.c_str());
        }
        break;
      case UPLOAD_FILE_END:
        if (!gHttpOtaStarted) break;
        if (!Update.end(true)) {
          Update.printError(Serial);
          gHttpOtaErrorMessage = otaUploadResultText();
          addLog("HTTP OTA end failed: %s", gHttpOtaErrorMessage.c_str());
        }
        break;
      case UPLOAD_FILE_ABORTED:
        if (gHttpOtaStarted) cancelOtaUpload();
        gHttpOtaErrorMessage = "OTA upload aborted";
        addLog("HTTP OTA upload aborted");
        break;
      default:
        break;
    }
    yield();
  });

  server.on("/api/v1/state", HTTP_GET, []() {
    if (!ensureAdminAuthenticated()) return;
    server.sendHeader("Cache-Control", "no-store");
    server.send(200, "application/json", buildStateJson());
  });

  server.on("/api/v1/logs", HTTP_GET, []() {
    if (!ensureAdminAuthenticated()) return;
    server.sendHeader("Cache-Control", "no-store");
    server.send(200, "text/plain", buildLogsText());
  });

  server.on("/api/v1/config", HTTP_GET, []() {
    if (!ensureAdminAuthenticated()) return;
    server.sendHeader("Cache-Control", "no-store");
    server.send(200, "application/json", buildConfigJson());
  });

  server.on("/api/v1/config", HTTP_POST, []() {
    if (!ensureAdminAuthenticated()) return;
    String error;
    if (updateConfigFromJson(server.arg("plain"), error)) sendJsonStatus(200, true, "configuration saved");
    else sendJsonStatus(400, false, error);
  });

  server.on("/api/v1/control", HTTP_POST, []() {
    if (!ensureAdminAuthenticated()) return;
    String error;
    if (handleControlJson(server.arg("plain"), error)) sendJsonStatus(200, true, "control applied");
    else sendJsonStatus(400, false, error);
  });

  server.on("/api/v1/reboot", HTTP_POST, []() {
    if (!ensureAdminAuthenticated()) return;
    scheduleRestart("api reboot", 1000U);
    sendJsonStatus(200, true, "reboot scheduled");
  });

  server.on("/api/v1/homekit-reset", HTTP_POST, []() {
    if (!ensureAdminAuthenticated()) return;
    homekitBridgeResetPairings();
    scheduleRestart("api homekit reset", 1000U);
    sendJsonStatus(200, true, "homekit pairings reset scheduled");
  });

  server.on("/api/v1/factory-reset", HTTP_POST, []() {
    if (!ensureAdminAuthenticated()) return;
    factoryResetAndRestart();
    sendJsonStatus(200, true, "factory reset scheduled");
  });

  server.onNotFound([]() {
    server.sendHeader("Location", setupAccessAllowed() ? "/setup" : "/app");
    server.send(302, "text/plain", "redirect");
  });
}

}  // namespace industrial_v2







