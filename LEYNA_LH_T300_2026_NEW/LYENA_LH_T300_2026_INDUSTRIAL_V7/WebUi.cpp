#include "WebUi.h"

#include <ArduinoJson.h>
#include <Update.h>

#if defined(ARDUINO_ARCH_ESP32)
#include <esp_ota_ops.h>
#include <esp_partition.h>
#endif

#include "IndustrialApp.h"

namespace industrial_v2 {

namespace {

bool gHttpOtaStarted = false;
String gHttpOtaErrorMessage;
static constexpr const char* kFsAppHtmlPath = "/webui/app.html";
static constexpr const char* kFsSetupHtmlPath = "/webui/setup.html";
static constexpr const char* kFsOtaHtmlPath = "/webui/ota.html";
static constexpr const char* kFsModbusMapHtmlPath = "/webui/modbus-map.html";
static constexpr const char* kFsCustomProgramHtmlPath = "/webui/custom-program.html";
static constexpr const char* kFsCustomProgramGuideHtmlPath = "/webui/custom-program-guide.html";

const uint8_t APP_HTML_GZ[] PROGMEM =
{
  0x1f, 0x8b, 0x08, 0x00, 0x00, 0x00, 0x00, 0x00, 0x02, 0xff, 0xed, 0x7d, 0x7b, 0x57, 0x1b, 0x49,
  0x92, 0xef, 0xff, 0xfe, 0x14, 0x65, 0xba, 0xc7, 0x25, 0x6d, 0x4b, 0x42, 0x12, 0xf8, 0x25, 0xb9,
  0x60, 0x31, 0xc6, 0x6d, 0xee, 0x80, 0xcd, 0x02, 0x76, 0xcf, 0x5c, 0x8f, 0xd7, 0x2e, 0xa4, 0x12,
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  0xff, 0x00, 0xed, 0xd8, 0x04, 0x71, 0x5b, 0xef, 0x00, 0x00,

};
static constexpr size_t APP_HTML_GZ_LEN = sizeof(APP_HTML_GZ);


const uint8_t OTA_HTML_GZ[] PROGMEM =
{
  0x1f, 0x8b, 0x08, 0x00, 0x00, 0x00, 0x00, 0x00, 0x02, 0xff, 0x95, 0x57, 0x6d, 0x73, 0xe3, 0xb6,
  0x11, 0xfe, 0xee, 0x5f, 0x81, 0x48, 0x73, 0x23, 0xa9, 0x21, 0x29, 0x52, 0x96, 0x75, 0x3a, 0x52,
  0xf2, 0x34, 0x69, 0x2f, 0x6d, 0x66, 0xd2, 0xa6, 0x13, 0x5f, 0xfb, 0xa5, 0xd3, 0x99, 0x03, 0x89,
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  0xb3, 0x69, 0x0e, 0x00, 0x00,

};
static constexpr size_t OTA_HTML_GZ_LEN = sizeof(OTA_HTML_GZ);


const uint8_t SETUP_HTML_GZ[] PROGMEM =
{
  0x1f, 0x8b, 0x08, 0x00, 0x00, 0x00, 0x00, 0x00, 0x02, 0xff, 0xad, 0x5a, 0xff, 0x77, 0x9b, 0x38,
  0x12, 0xff, 0xbd, 0x7f, 0x85, 0xea, 0xec, 0x2e, 0xe6, 0x0e, 0xb0, 0x71, 0x9d, 0xd4, 0x85, 0xe0,
  0x5e, 0x76, 0xdb, 0xdd, 0xf6, 0x6e, 0xdb, 0xe6, 0x9d, 0x73, 0x77, 0x3f, 0xec, 0xdb, 0xf7, 0x22,
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  0x00,

};
static constexpr size_t SETUP_HTML_GZ_LEN = sizeof(SETUP_HTML_GZ);

const char MODBUS_MAP_HTML[] PROGMEM = R"rawliteral(<!doctype html>
<html lang="en">
<head>
<meta charset="utf-8">
<meta name="viewport" content="width=device-width,initial-scale=1">
<title>Modbus Map Editor</title>
<style>
:root{--bg:#09131c;--panel:#102433;--panel2:#0b1b26;--line:#2f6077;--ink:#edf5f8;--muted:#98b5c7;--ok:#8be08d;--err:#ff9b9b;--accent:#ff9f4d;--shadow:0 14px 32px rgba(0,0,0,.28)}
*{box-sizing:border-box}
body{margin:0;font-family:"Trebuchet MS","Gill Sans",sans-serif;background:radial-gradient(circle at top left,#1f4456 0,#09131c 48%),linear-gradient(150deg,#09131c,#153244 66%,#1d4255);color:var(--ink)}
.wrap{max-width:1100px;margin:0 auto;padding:20px}
h1{margin:0 0 6px;font-size:30px;letter-spacing:.04em}
.muted{color:var(--muted);margin:0 0 10px}
.panel{background:linear-gradient(180deg,rgba(255,255,255,.05),rgba(255,255,255,.02));border:1px solid rgba(255,255,255,.12);border-radius:16px;padding:14px;margin-bottom:14px;box-shadow:var(--shadow)}
.hidden{display:none}
.section-head{display:flex;justify-content:space-between;align-items:center;gap:10px;flex-wrap:wrap;margin-bottom:10px}
.section-head h3{margin:0;font-size:15px;letter-spacing:.08em;text-transform:uppercase;color:#dfeaf0}
.section-note{font-size:11px;color:var(--muted)}
.map-grid{display:grid;grid-template-columns:repeat(auto-fit,minmax(240px,1fr));gap:10px}
.map-card{background:var(--panel2);border:1px solid rgba(255,255,255,.09);border-radius:12px;padding:10px;display:grid;gap:8px}
.map-title{display:flex;align-items:center;justify-content:space-between;font-size:12px;color:#dce8ee;text-transform:uppercase;letter-spacing:.08em}
.chip{padding:4px 8px;border-radius:999px;background:#173243;border:1px solid rgba(255,255,255,.12);font-size:11px;color:#d5e8f1}
label{display:block;font-size:11px;color:var(--muted);letter-spacing:.06em;text-transform:uppercase}
input[type="number"]{width:100%;padding:10px 11px;border-radius:10px;border:1px solid var(--line);background:#0a151d;color:var(--ink);min-height:40px}
.word-toggle{display:flex;align-items:center;justify-content:space-between;gap:10px;padding:8px 10px;border:1px solid var(--line);border-radius:10px;background:#0a151d}
.word-toggle span{font-size:12px;color:#d7e7ef}
.word-toggle small{display:block;color:var(--muted);font-size:10px}
.switch{position:relative;width:42px;height:24px;display:inline-block;flex:0 0 auto}
.switch input{opacity:0;width:0;height:0;position:absolute}
.slider{position:absolute;inset:0;background:#2c4553;border-radius:999px;border:1px solid rgba(255,255,255,.18);transition:all .2s ease}
.slider:before{content:"";position:absolute;width:18px;height:18px;left:2px;top:2px;border-radius:50%;background:#dbe7ed;transition:all .2s ease}
.switch input:checked+.slider{background:linear-gradient(135deg,#0f9f88,#14c7aa)}
.switch input:checked+.slider:before{transform:translateX(18px);background:#ffffff}
.actions{display:flex;flex-wrap:wrap;gap:10px;margin-top:12px}
button,a{padding:10px 14px;border-radius:10px;border:1px solid var(--line);background:#0a151d;color:var(--ink);text-decoration:none;cursor:pointer;min-height:42px}
button.primary{background:linear-gradient(135deg,var(--accent),#ffc178);color:#26160a;border:none;font-weight:700}
#status{margin-top:10px;padding:10px;border-radius:10px;background:#0a151d;border:1px solid var(--line);white-space:pre-wrap}
.ok{color:var(--ok)}
.err{color:var(--err)}
@media (max-width:760px){.wrap{padding:12px}.actions{flex-direction:column}.actions button,.actions a{width:100%}}
</style>
</head>
<body>
<div class="wrap">
  <h1>Modbus Map Editor</h1>
  <p class="muted">Editor responsive para direccion y formato por canal (1 o 2 registros).</p>
  <p class="muted" id="mode-note">Modo actual: --</p>

  <div class="panel" id="panel-publish">
    <div class="section-head">
      <h3>Temperatura (publicacion)</h3>
      <div class="section-note">Direcciones usadas para publicar en local/cloud.</div>
    </div>
    <div class="map-grid" id="temp-grid"></div>
    <div class="section-head" style="margin-top:12px">
      <h3>Humedad (publicacion)</h3>
      <div class="section-note">Configura H1-H2 segun tus registros remotos.</div>
    </div>
    <div class="map-grid" id="hum-grid"></div>
  </div>

  <div class="panel" id="panel-hybrid-source">
    <div class="section-head">
      <h3>Temperatura (mirror/hybrid source)</h3>
      <div class="section-note">Origen remoto usado por modo Hybrid.</div>
    </div>
    <div class="map-grid" id="temp-mirror-grid"></div>
    <div class="section-head" style="margin-top:12px">
      <h3>Humedad (mirror/hybrid source)</h3>
      <div class="section-note">Mirror source para H1-H2.</div>
    </div>
    <div class="map-grid" id="hum-mirror-grid"></div>
  </div>

  <div class="actions">
    <button class="primary" id="save">Guardar mapeo</button>
    <button id="reload">Recargar</button>
    <a href="/app">Volver a /app</a>
  </div>

  <div id="status">Cargando...</div>
</div>

<script>
const SPECS=[
  {key:'modbusTempRegisters',wordsKey:'modbusTempRegisterWords',count:4,prefix:'T',host:'temp-grid'},
  {key:'modbusHumRegisters',wordsKey:'modbusHumRegisterWords',count:2,prefix:'H',host:'hum-grid'},
  {key:'modbusMirrorTempRegisters',wordsKey:'modbusMirrorTempRegisterWords',count:4,prefix:'T',host:'temp-mirror-grid'},
  {key:'modbusMirrorHumRegisters',wordsKey:'modbusMirrorHumRegisterWords',count:2,prefix:'H',host:'hum-mirror-grid'}
];

let cfg={};
function el(id){return document.getElementById(id)}
function setStatus(text,kind){const n=el('status');n.textContent=text;n.className=kind||''}
function toInt(v,fallback=0){const n=Number(v);return Number.isFinite(n)?Math.trunc(n):fallback}
function clamp(v,min,max){return Math.max(min,Math.min(max,v))}

function modbusModeLabel(mode){
  if(mode===3)return 'TCP to RTU';
  if(mode===4)return 'Slave to Me';
  if(mode===5)return 'Slave to Me Hybrid TCP';
  if(mode===1)return 'RTU Server';
  if(mode===2)return 'TCP Server';
  return 'Off';
}

function applyModeVisibility(){
  const mode=toInt(cfg.modbusMode,0);
  const publishPanel=el('panel-publish');
  const hybridPanel=el('panel-hybrid-source');
  const modeNote=el('mode-note');
  if(modeNote){
    modeNote.textContent=`Modo actual: ${modbusModeLabel(mode)} (mode=${mode})`;
  }

  const isTcpRtu=mode===3;
  const isSlaveToMe=mode===4;
  const isHybrid=mode===5;

  if(publishPanel){
    publishPanel.classList.toggle('hidden',!(isTcpRtu||isSlaveToMe||isHybrid));
  }
  if(hybridPanel){
    hybridPanel.classList.toggle('hidden',!isHybrid);
  }

  if(modeNote){
    if(isHybrid){
      modeNote.textContent+=' | En Hybrid, el origen remoto usa bloques mirror/hybrid source.';
    }else if(isTcpRtu||isSlaveToMe){
      modeNote.textContent+=' | En este modo, el origen remoto usa bloques de publicacion.';
    }else{
      modeNote.textContent+=' | Este editor aplica principalmente a TCP-RTU (3), Slave to Me (4) y Hybrid (5).';
    }
  }
}

function renderCard(spec,index,addrValue,twoRegs){
  const card=document.createElement('div');
  card.className='map-card';

  const title=document.createElement('div');
  title.className='map-title';
  title.innerHTML=`<span>Canal ${spec.prefix}${index+1}</span><span class="chip">${spec.prefix}${index+1}</span>`;

  const addrWrap=document.createElement('div');
  const addrLabel=document.createElement('label');
  addrLabel.textContent='Direccion Modbus';
  const addr=document.createElement('input');
  addr.id=`${spec.key}-${index}-addr`;
  addr.type='number';
  addr.step='1';
  addr.min='0';
  addr.max='65535';
  addr.value=clamp(toInt(addrValue,0),0,65535);
  addrWrap.append(addrLabel,addr);

  const toggle=document.createElement('label');
  toggle.className='word-toggle';
  const text=document.createElement('span');
  text.innerHTML='2 registros (32-bit)<small>Activa para int32/float en 2 words</small>';
  const switchWrap=document.createElement('span');
  switchWrap.className='switch';
  const chk=document.createElement('input');
  chk.id=`${spec.key}-${index}-w2`;
  chk.type='checkbox';
  chk.checked=Boolean(twoRegs);
  const slider=document.createElement('span');
  slider.className='slider';
  switchWrap.append(chk,slider);
  toggle.append(text,switchWrap);

  card.append(title,addrWrap,toggle);
  return card;
}

function render(){
  SPECS.forEach(spec=>{
    const host=el(spec.host);
    host.innerHTML='';
    const regs=Array.isArray(cfg[spec.key])?cfg[spec.key]:[];
    const words=Array.isArray(cfg[spec.wordsKey])?cfg[spec.wordsKey]:[];
    for(let i=0;i<spec.count;i++){
      const addr=regs[i]??0;
      const twoRegs=toInt(words[i]??1,1)>1;
      host.appendChild(renderCard(spec,i,addr,twoRegs));
    }
  });
  applyModeVisibility();
}

function collectPayload(){
  const payload={};
  SPECS.forEach(spec=>{
    const regs=[];
    const words=[];
    for(let i=0;i<spec.count;i++){
      const addrNode=el(`${spec.key}-${i}-addr`);
      const twoRegsNode=el(`${spec.key}-${i}-w2`);
      regs.push(clamp(toInt(addrNode?addrNode.value:0,0),0,65535));
      words.push(twoRegsNode&&twoRegsNode.checked?2:1);
    }
    payload[spec.key]=regs;
    payload[spec.wordsKey]=words;
  });
  return payload;
}

async function loadConfig(){
  const res=await fetch('/api/v1/config',{cache:'no-store'});
  if(!res.ok)throw new Error(await res.text()||res.statusText);
  cfg=await res.json();
  render();
  setStatus('Configuracion cargada.','ok');
}

async function save(){
  try{
    const payload=collectPayload();
    const res=await fetch('/api/v1/config',{method:'POST',headers:{'Content-Type':'application/json'},body:JSON.stringify(payload)});
    if(!res.ok)throw new Error(await res.text()||res.statusText);
    await loadConfig();
    setStatus('Mapeo guardado correctamente.','ok');
  }catch(error){
    setStatus('Error guardando: '+error.message,'err');
  }
}

el('save').onclick=()=>{void save()};
el('reload').onclick=()=>{void loadConfig()};
void loadConfig().catch(error=>setStatus('Error cargando: '+error.message,'err'));
</script>
</body>
</html>
)rawliteral";

const char CUSTOM_PROGRAM_HTML[] PROGMEM = R"rawliteral(<!doctype html>
<html lang="es">
<head>
<meta charset="utf-8">
<meta name="viewport" content="width=device-width,initial-scale=1">
<title>Custom WorkMode Program</title>
<style>
:root{--bg:#0d1822;--panel:#152738;--line:#32556f;--ink:#eef4f7;--muted:#9db4c2;--ok:#8be08d;--err:#ff9b9b;--warn:#ffd67a;--accent:#5ec7ff}
*{box-sizing:border-box}
body{margin:0;font-family:"Trebuchet MS","Gill Sans",sans-serif;background:linear-gradient(150deg,#08121a,#102331 58%,#193648);color:var(--ink)}
.wrap{max-width:1100px;margin:0 auto;padding:20px}
h1{margin:0 0 6px;font-size:28px}
.muted{color:var(--muted);margin:0 0 16px}
.panel{background:rgba(255,255,255,.03);border:1px solid rgba(255,255,255,.12);border-radius:14px;padding:14px;margin-bottom:14px}
.grid{display:grid;grid-template-columns:repeat(auto-fit,minmax(220px,1fr));gap:10px}
label{display:block;font-size:12px;color:var(--muted);margin-bottom:6px}
select,textarea{width:100%;padding:10px;border-radius:10px;border:1px solid var(--line);background:#0a151d;color:var(--ink)}
textarea{min-height:340px;font-family:Consolas,"Courier New",monospace;resize:vertical;line-height:1.35}
.actions{display:flex;flex-wrap:wrap;gap:10px;margin-top:12px}
button,a{padding:10px 14px;border-radius:10px;border:1px solid var(--line);background:#0a151d;color:var(--ink);text-decoration:none;cursor:pointer}
button.primary{background:linear-gradient(135deg,var(--accent),#a9ecff);color:#072432;border:none;font-weight:700}
#status{margin-top:10px;padding:10px;border-radius:10px;background:#0a151d;border:1px solid var(--line);white-space:pre-wrap}
.ok{color:var(--ok)}
.err{color:var(--err)}
.warn{color:var(--warn)}
.hint{font-size:12px;color:var(--muted);line-height:1.5}
.docs{display:grid;grid-template-columns:repeat(auto-fit,minmax(260px,1fr));gap:10px}
.doc{background:#0a151d;border:1px solid var(--line);border-radius:10px;padding:10px}
.doc h3{margin:0 0 8px;font-size:14px}
.doc ul{margin:0;padding-left:18px}
.doc li{margin:4px 0;color:var(--muted);font-size:12px;line-height:1.45}
.mono{font-family:Consolas,"Courier New",monospace;color:var(--ink)}
.code{display:block;margin-top:8px;padding:8px;border-radius:8px;background:#081019;border:1px solid #27455d;white-space:pre-wrap;font-family:Consolas,"Courier New",monospace;font-size:12px;color:#d8ecf7}
@media (max-width:700px){.wrap{padding:12px}.actions{flex-direction:column}.actions button,.actions a{width:100%}}
</style>
</head>
<body>
<div class="wrap">
  <h1>Programa Custom (WORK_CUSTOM)</h1>
  <p class="muted">Editor de reglas y secuencias. La documentacion completa ahora vive en una pagina separada para mantener este editor limpio.</p>

  <div class="panel">
    <div class="grid">
      <div>
        <label for="workMode">Modo de trabajo</label>
        <select id="workMode">
          <option value="0">Desactivado</option>
          <option value="1">Termostato</option>
          <option value="2">Pushbutton</option>
          <option value="3">Manual</option>
          <option value="4">Custom</option>
        </select>
      </div>
      <div>
        <label>Estado compilacion</label>
        <div id="compile-status" class="hint">--</div>
      </div>
    </div>
    <div class="actions">
      <button class="primary" id="save">Guardar programa</button>
      <button id="reload">Recargar</button>
      <select id="example-picker">
        <option value="">Galeria de ejemplos</option>
        <option value="garage">Puerta de garaje</option>
        <option value="windows-heat">Cerrar ventanas si hace calor</option>
        <option value="hood-double">Campana doble exacta</option>
        <option value="irrigation">Riego automatico</option>
        <option value="lights-button">Luces con pulsador</option>
        <option value="onboot-stagger">ONBOOT escalonado (nuevo)</option>
        <option value="full-reference">Ejemplo completo de referencia</option>
        <option value="marmita-cool">Enfriamiento de marmita por fases</option>
        <option value="blink">Plantilla Blink</option>
        <option value="pasteurizer">Plantilla Pasteurizador</option>
        <option value="wash">Plantilla Lavado</option>
      </select>
      <button id="load-example">Cargar ejemplo</button>
      <button id="insert-example">Insertar ejemplo</button>
      <button id="pulse-vin1">Pulsar VIN1</button>
      <button id="pulse-vin2">Pulsar VIN2</button>
      <button id="pulse-vin3">Pulsar VIN3</button>
      <button id="pulse-vin4">Pulsar VIN4</button>
      <a href="/custom-program-guide">Guia completa</a>
      <a href="/app">Volver a /app</a>
    </div>
  </div>

  <div class="panel">
    <label for="program">Programa custom</label>
    <textarea id="program" spellcheck="false"></textarea>
    <p class="hint">
Legacy (compatible): SET, BLINK, TIMER, ONBOOT, ONCHANGE, PULSE, THERMOSTAT, IF, IFALL, IFANY.<br>
Secuencia PROGRAM (visual): START IN=IN1 o START VIN=VIN1, STEP REL=REL1 STATE=ON TIME=5000, WAIT TIME=2000, WAITUNTIL ..., LOOP ... ENDLOOP, SAFETY ... y END.<br>
Comparadores: == != &gt; &gt;= &lt; &lt;=.
    </p>
  </div>

  <div class="panel">
    <div class="docs">
      <div class="doc">
        <h3>Ejemplo visual rapido</h3>
        <span class="code">PROGRAM NAME=ARRANQUE_RAPIDO
START VIN=VIN1
STEP REL=REL1 STATE=ON TIME=5000
WAIT TIME=1000
STEP REL=REL1 STATE=OFF
SAFETY IN=IN4 ACTION=ALL_OFF
END</span>
      </div>
      <div class="doc">
        <h3>API y cloud para VIN</h3>
        <ul>
          <li><span class="mono">POST /api/v1/control</span> con <span class="mono">{"pulseVirtualInput":"VIN1"}</span>.</li>
          <li>En cloud: usar <span class="mono">desiredState.pulseVirtualInput</span> para pulsos.</li>
          <li><span class="mono">GET /api/v1/state</span> expone <span class="mono">virtualInputs</span> y estado de secuencia.</li>
        </ul>
      </div>
      <div class="doc">
        <h3>Documentacion completa</h3>
        <ul>
          <li>Comandos legacy y secuencia PROGRAM, linea por linea.</li>
          <li>Ejemplos ONBOOT, MARMITA_COOL y payloads cloud.</li>
          <li>Prioridades de seguridad y reserva de reles.</li>
        </ul>
        <div class="actions" style="margin-top:10px">
          <a href="/custom-program-guide">Abrir /custom-program-guide</a>
        </div>
      </div>
    </div>
  </div>

  <div id="status">Cargando...</div>
</div>

<script>
let cfg={};
let state={};

function el(id){return document.getElementById(id)}
function setStatus(text,kind){const n=el('status');n.textContent=text;n.className=kind||''}
function toInt(v,fallback=0){const n=Number(v);return Number.isFinite(n)?Math.trunc(n):fallback}

const templates={
  garage:[
    '# Puerta de garaje',
    '# Pulsador en IN1 y motor en REL1',
    'SET REL1 OFF',
    'PULSE IN1 REL1 1200 1 300'
  ].join('\n'),
  'windows-heat':[
    '# Cerrar ventanas si hace calor',
    '# REL1 acciona cierre de ventana',
    'IF TEMP1 >= 30 THEN REL1 ON',
    'IF TEMP1 <= 27 THEN REL1 OFF'
  ].join('\n'),
  'hood-double':[
    '# Campana doble exacta',
    '# REL1 y REL2 activos solo con doble condicion',
    'IFALL TEMP1 >= 65 HUM1 >= 70 THEN REL1 ON',
    'IFALL TEMP1 >= 65 HUM1 >= 70 THEN REL2 ON',
    'IFANY TEMP1 < 63 HUM1 < 68 THEN REL1 OFF',
    'IFANY TEMP1 < 63 HUM1 < 68 THEN REL2 OFF'
  ].join('\n'),
  irrigation:[
    '# Riego automatico',
    '# IN1 habilita riego, REL1 bomba, REL2 valvula',
    'IF IN1 == ON THEN REL2 ON',
    'IF IN1 == OFF THEN REL2 OFF',
    'TIMER REL1 15000 120000',
    'IF IN1 == OFF THEN REL1 OFF'
  ].join('\n'),
  'lights-button':[
    '# Luces con pulsador',
    'ONCHANGE IN1 TOGGLE REL1',
    'ONCHANGE IN2 TOGGLE REL2'
  ].join('\n'),
  'onboot-stagger':[
    '# ONBOOT escalonado',
    '# Cada rele dispara una sola vez tras arranque',
    'ONBOOT REL1 10000 2000',
    'ONBOOT REL2 12000 2000',
    'ONBOOT REL3 14000 2000'
  ].join('\n'),
  'full-reference':[
    '# Ejemplo completo de referencia',
    'SET REL1 OFF',
    'BLINK REL2 500 500',
    'TIMER REL3 1200 1800',
    'ONBOOT REL1 10000 2000',
    'ONBOOT REL2 12000 2000',
    'ONBOOT REL3 14000 2000',
    'ONCHANGE IN1 TOGGLE REL1',
    'PULSE IN2 REL2 1000 2 300',
    'THERMOSTAT REL1 TEMP1 4.0 0.8 COOL',
    'IF TEMP1 >= 8 THEN REL4 ON',
    'IF HUM1 >= 80 THEN REL4 OFF',
    'IF IN3 == ON THEN REL3 OFF',
    'IFALL TEMP1 > 30 HUM1 > 70 THEN REL2 ON',
    'IFANY IN1 == ON IN2 == ON THEN REL2 OFF'
  ].join('\n'),
  'marmita-cool':[
    'PROGRAM NAME=MARMITA_COOL',
    'START IN=IN1',
    '',
    'SET REL=REL1 STATE=OFF',
    'SET REL=REL2 STATE=OFF',
    'SET REL=REL3 STATE=OFF',
    'SET REL=REL4 STATE=OFF',
    '',
    'LOOP MAX=8 UNTIL=TEMP1<=40.0 STABLE=30000',
    'STEP REL=REL1 STATE=ON TIME=30000',
    'STEP REL=REL2 STATE=ON TIME=45000',
    'WAIT TIME=300000',
    'ENDLOOP',
    '',
    'STEP REL=REL3 STATE=ON',
    'STEP REL=REL4 STATE=ON',
    'WAITUNTIL TEMP=TEMP1 OP=<= VALUE=10.0 STABLE=60000 MAX=3600000',
    'STEP REL=REL3 STATE=OFF',
    'STEP REL=REL4 STATE=OFF',
    '',
    'SAFETY IN=IN4 ACTION=ALL_OFF',
    'END'
  ].join('\n'),
  blink:[
    '# Blink simple',
    'BLINK REL1 500 500',
    'SET REL2 OFF',
    'SET REL3 OFF',
    'SET REL4 OFF'
  ].join('\n'),
  pasteurizer:[
    '# Pasteurizador basico',
    '# REL1: resistencia',
    '# REL2: bomba recirculacion',
    '# REL3: alarma alta',
    'THERMOSTAT REL1 TEMP1 72 1 HEAT',
    'SET REL2 ON',
    'IF TEMP1 >= 78 THEN REL3 ON',
    'IF TEMP1 <= 76 THEN REL3 OFF'
  ].join('\n'),
  wash:[
    '# Lavado CIP simple',
    '# REL1 bomba ciclica',
    '# REL2 valvula enjuague',
    'BLINK REL1 12000 8000',
    'IF TEMP1 >= 45 THEN REL2 ON',
    'IF TEMP1 <= 42 THEN REL2 OFF',
    'SET REL3 OFF',
    'SET REL4 OFF'
  ].join('\n')
};

function render(){
  el('workMode').value=String(toInt(cfg.workMode,1));
  el('program').value=typeof cfg.customProgram==='string'?cfg.customProgram:'';
  const valid=Boolean(state.customProgramValid);
  const count=toInt(state.customProgramRuleCount,0);
  const mode=String(state.customProgramMode||'rules');
  const error=state.customProgramError||'';
  const seqState=String(state.sequenceState||'IDLE');
  const seqStep=toInt(state.sequenceCurrentStep,0);
  const seqLoop=toInt(state.sequenceCurrentLoop,0);
  const seqErr=state.sequenceError||'';
  const seqErrLine=toInt(state.sequenceErrorLine,0);
  const node=el('compile-status');
  if(valid){
    let text='Valido ('+count+' reglas/pasos) | modo: '+mode;
    if(mode!=='rules'){
      text+=' | secuencia: '+seqState+' (step '+seqStep+', loop '+seqLoop+')';
    }
    if(seqErr){
      text+=' | sequenceError: '+seqErr+(seqErrLine?(' @L'+seqErrLine):'');
    }
    node.textContent=text;
    node.className='hint ok';
  }else if(error){
    node.textContent='Invalido: '+error+(seqErr?(' | sequenceError: '+seqErr):'');
    node.className='hint err';
  }else{
    node.textContent='Sin compilar';
    node.className='hint warn';
  }
}

function selectedExample(){
  const key=String(el('example-picker').value||'');
  if(!key || !templates[key]) return '';
  return templates[key];
}

function loadSelectedExample(){
  const text=selectedExample();
  if(!text){
    setStatus('Selecciona un ejemplo de la galeria.', 'warn');
    return;
  }
  el('program').value=text;
  setStatus('Ejemplo cargado en el editor.', 'ok');
}

function insertSelectedExample(){
  const text=selectedExample();
  if(!text){
    setStatus('Selecciona un ejemplo de la galeria.', 'warn');
    return;
  }
  const current=el('program').value;
  el('program').value=current?current+'\n\n'+text:text;
  setStatus('Ejemplo insertado en el editor.', 'ok');
}

async function pulseVirtualInput(label){
  try{
    const payload={pulseVirtualInput:label};
    const res=await fetch('/api/v1/control',{
      method:'POST',
      headers:{'Content-Type':'application/json'},
      body:JSON.stringify(payload)
    });
    if(!res.ok)throw new Error(await res.text()||res.statusText);
    await loadAll();
    setStatus('Pulso virtual enviado: '+label, 'ok');
  }catch(error){
    setStatus('Error pulsando '+label+': '+error.message, 'err');
  }
}

async function loadAll(){
  const [cfgRes,stateRes]=await Promise.all([
    fetch('/api/v1/config',{cache:'no-store'}),
    fetch('/api/v1/state',{cache:'no-store'})
  ]);
  if(!cfgRes.ok)throw new Error(await cfgRes.text()||cfgRes.statusText);
  if(!stateRes.ok)throw new Error(await stateRes.text()||stateRes.statusText);
  cfg=await cfgRes.json();
  state=await stateRes.json();
  render();
  setStatus('Configuracion custom cargada.', 'ok');
}

async function saveProgram(){
  try{
    const payload={
      workMode:toInt(el('workMode').value,1),
      customProgram:el('program').value
    };
    const res=await fetch('/api/v1/config',{
      method:'POST',
      headers:{'Content-Type':'application/json'},
      body:JSON.stringify(payload)
    });
    if(!res.ok)throw new Error(await res.text()||res.statusText);
    await loadAll();
    if(state.customProgramValid){
      setStatus('Programa guardado y validado. Modo actual: '+toInt(cfg.workMode,1), 'ok');
    }else{
      setStatus('Programa guardado pero invalido: '+(state.customProgramError||'sin detalle'), 'warn');
    }
  }catch(error){
    setStatus('Error guardando: '+error.message, 'err');
  }
}

el('save').onclick=()=>{void saveProgram()};
el('reload').onclick=()=>{void loadAll()};
el('load-example').onclick=loadSelectedExample;
el('insert-example').onclick=insertSelectedExample;
el('pulse-vin1').onclick=()=>{void pulseVirtualInput('VIN1')};
el('pulse-vin2').onclick=()=>{void pulseVirtualInput('VIN2')};
el('pulse-vin3').onclick=()=>{void pulseVirtualInput('VIN3')};
el('pulse-vin4').onclick=()=>{void pulseVirtualInput('VIN4')};
void loadAll().catch(error=>setStatus('Error cargando: '+error.message, 'err'));
</script>
</body>
</html>
)rawliteral";

const char CUSTOM_PROGRAM_GUIDE_HTML[] PROGMEM = R"rawliteral(<!doctype html>
<html lang="es">
<head>
<meta charset="utf-8">
<meta name="viewport" content="width=device-width,initial-scale=1">
<title>Guia Custom Program</title>
<style>
:root{--bg:#08131a;--panel:#102633;--ink:#eef4f7;--muted:#9bb5c7;--line:#2a5069;--accent:#4ec6ff;--ok:#87df8a;--warn:#ffd37a}
*{box-sizing:border-box}
body{margin:0;font-family:"Trebuchet MS","Gill Sans",sans-serif;background:radial-gradient(circle at 8% 0,#1b3e51 0,#08131a 45%),linear-gradient(145deg,#08131a,#122736 58%,#1a3443);color:var(--ink)}
.wrap{max-width:1180px;margin:0 auto;padding:20px}
.panel{background:rgba(255,255,255,.03);border:1px solid rgba(255,255,255,.12);border-radius:14px;padding:14px;margin-bottom:14px}
h1{margin:0 0 6px;font-size:30px}
h2{margin:0 0 10px;font-size:18px;letter-spacing:.03em}
h3{margin:0 0 8px;font-size:15px}
.muted{color:var(--muted);line-height:1.5}
.grid{display:grid;grid-template-columns:repeat(auto-fit,minmax(260px,1fr));gap:10px}
.actions{display:flex;flex-wrap:wrap;gap:10px;margin-top:10px}
a,button{padding:10px 14px;border-radius:10px;border:1px solid var(--line);background:#0a1a23;color:var(--ink);text-decoration:none}
a.primary{background:linear-gradient(135deg,var(--accent),#afe7ff);color:#072737;border:none;font-weight:700}
ul{margin:0;padding-left:18px}
li{margin:6px 0;color:var(--muted);line-height:1.45}
.code{margin:0;padding:10px;border-radius:10px;background:#07121a;border:1px solid #244a62;color:#d4ecf8;white-space:pre-wrap;font-family:Consolas,"Courier New",monospace;font-size:12px;line-height:1.35}
.kpi{display:flex;flex-wrap:wrap;gap:8px}
.badge{padding:6px 10px;border-radius:999px;border:1px solid var(--line);font-size:12px;background:#08161f;color:var(--muted)}
.table{display:grid;grid-template-columns:repeat(auto-fit,minmax(290px,1fr));gap:10px}
.block{background:#08161f;border:1px solid var(--line);border-radius:10px;padding:10px}
.block p{margin:0;color:var(--muted);line-height:1.45}
.toc a{display:block;margin:4px 0}
@media (max-width:760px){.wrap{padding:12px}.actions{flex-direction:column}a,button{width:100%}}
</style>
</head>
<body>
<div class="wrap">
  <h1>Guia completa de Custom Program</h1>
  <p class="muted">Pagina independiente de <span class="code" style="display:inline;padding:2px 6px">/custom-program</span> para documentar toda la sintaxis legacy y la nueva secuencia PROGRAM sin romper compatibilidad.</p>

  <div class="panel">
    <div class="actions">
      <a class="primary" href="/custom-program">Abrir editor /custom-program</a>
      <a href="/app">Volver a /app</a>
    </div>
    <div class="kpi" style="margin-top:10px">
      <span class="badge">Compatible: SET, BLINK, TIMER, ONBOOT, ONCHANGE, PULSE, THERMOSTAT, IF, IFALL, IFANY</span>
      <span class="badge">Nuevo: PROGRAM / STEP / WAIT / WAITUNTIL / LOOP / SAFETY</span>
      <span class="badge">VIN soportado: VIN1..VIN4</span>
    </div>
  </div>

  <div class="panel toc">
    <h2>Indice rapido</h2>
    <a href="#campos">1. Campos y operadores</a>
    <a href="#legacy">2. Comandos legacy (compatibles)</a>
    <a href="#sequence">3. Secuencia PROGRAM por pasos</a>
    <a href="#vin">4. Entradas virtuales VIN y disparo remoto</a>
    <a href="#api">5. API local y cloud</a>
    <a href="#state">6. Estado parser/secuencia (/api/v1/state)</a>
    <a href="#examples">7. Ejemplos listos para copiar</a>
  </div>

  <div class="panel" id="campos">
    <h2>1) Campos y operadores</h2>
    <div class="grid">
      <div class="block">
        <h3>Fuentes disponibles</h3>
        <ul>
          <li><span class="code" style="display:inline;padding:2px 6px">REL1..REL4</span>: salidas/reles.</li>
          <li><span class="code" style="display:inline;padding:2px 6px">IN1..IN4</span>: entradas digitales fisicas.</li>
          <li><span class="code" style="display:inline;padding:2px 6px">VIN1..VIN4</span>: entradas virtuales.</li>
          <li><span class="code" style="display:inline;padding:2px 6px">TEMP1..TEMP4</span>: temperatura.</li>
          <li><span class="code" style="display:inline;padding:2px 6px">HUM1..HUM2</span>: humedad.</li>
        </ul>
      </div>
      <div class="block">
        <h3>Comparadores y comentarios</h3>
        <ul>
          <li>Operadores: <span class="code" style="display:inline;padding:2px 6px">== != &gt; &gt;= &lt; &lt;=</span>.</li>
          <li>Comentarios por linea: <span class="code" style="display:inline;padding:2px 6px">// texto</span>.</li>
          <li>Comentarios inline: <span class="code" style="display:inline;padding:2px 6px"># texto</span>.</li>
          <li>No soporta expresiones libres <span class="code" style="display:inline;padding:2px 6px">+ - * / () ELSE</span>.</li>
        </ul>
      </div>
    </div>
  </div>

  <div class="panel" id="legacy">
    <h2>2) Comandos legacy (compatibles)</h2>
    <div class="table">
      <div class="block"><h3>SET</h3><p>Fija un rele.</p><pre class="code">SET REL1 ON
SET REL2 OFF</pre></div>
      <div class="block"><h3>BLINK</h3><p>Parpadeo continuo.</p><pre class="code">BLINK REL1 500 500</pre></div>
      <div class="block"><h3>TIMER</h3><p>Ciclo ON/OFF por tiempos.</p><pre class="code">TIMER REL2 15000 120000</pre></div>
      <div class="block"><h3>ONBOOT</h3><p>Pulso unico tras arranque.</p><pre class="code">ONBOOT REL1 10000 2000
ONBOOT REL2 12000 2000
ONBOOT REL3 14000 2000</pre></div>
      <div class="block"><h3>ONCHANGE</h3><p>Accion por cambio de entrada.</p><pre class="code">ONCHANGE IN1 TOGGLE REL1</pre></div>
      <div class="block"><h3>PULSE</h3><p>Serie de pulsos sobre rele.</p><pre class="code">PULSE IN2 REL2 1000 2 300</pre></div>
      <div class="block"><h3>THERMOSTAT</h3><p>Control con histeresis.</p><pre class="code">THERMOSTAT REL1 TEMP1 4.0 0.8 COOL</pre></div>
      <div class="block"><h3>IF / IFALL / IFANY</h3><p>Condiciones simples o dobles.</p><pre class="code">IF TEMP1 &gt;= 8 THEN REL4 ON
IFALL TEMP1 &gt; 30 HUM1 &gt; 70 THEN REL2 ON
IFANY IN1 == ON IN2 == ON THEN REL2 OFF</pre></div>
    </div>
  </div>

  <div class="panel" id="sequence">
    <h2>3) Secuencia PROGRAM por pasos</h2>
    <p class="muted">Sintaxis visual recomendada en formato clave=valor. El motor es no bloqueante (millis), con reserva de reles y prioridad de seguridad.</p>
    <div class="table">
      <div class="block"><h3>Inicio y fin</h3><pre class="code">PROGRAM NAME=MARMITA_COOL
START IN=IN1
...
END</pre></div>
      <div class="block"><h3>SET y STEP</h3><pre class="code">SET REL=REL1 STATE=OFF
STEP REL=REL1 STATE=ON TIME=5000
STEP REL=REL1 STATE=OFF</pre></div>
      <div class="block"><h3>WAIT y WAITUNTIL</h3><pre class="code">WAIT TIME=300000
WAITUNTIL TEMP=TEMP1 OP=&lt;= VALUE=10.0 STABLE=60000 MAX=3600000</pre></div>
      <div class="block"><h3>LOOP</h3><pre class="code">LOOP MAX=8 UNTIL=TEMP1&lt;=40.0 STABLE=30000
...
ENDLOOP</pre></div>
      <div class="block"><h3>SAFETY</h3><pre class="code">SAFETY IN=IN4 ACTION=ALL_OFF
SAFETY VIN=VIN2 ACTION=ALL_OFF</pre></div>
      <div class="block"><h3>Limites clave</h3><ul><li>Maximo 1 PROGRAM.</li><li>Maximo 1 LOOP, sin anidado.</li><li>Maximo 24 pasos ejecutables.</li><li>Tiempos 50..86400000 ms.</li><li>Reles usados quedan reservados mientras corre la secuencia.</li></ul></div>
    </div>
  </div>

  <div class="panel" id="vin">
    <h2>4) Entradas virtuales VIN</h2>
    <div class="grid">
      <div class="block">
        <h3>Arranque por VIN</h3>
        <pre class="code">PROGRAM NAME=VIN_START
START VIN=VIN1
STEP REL=REL1 STATE=ON TIME=1000
END</pre>
        <p>El arranque usa flanco ascendente OFF -&gt; ON, igual que IN fisica.</p>
      </div>
      <div class="block">
        <h3>Parada virtual opcional</h3>
        <pre class="code">SAFETY VIN=VIN2 ACTION=ALL_OFF</pre>
        <p>Sirve como paro remoto desde UI/cloud. Para emergencia real, usa tambien una entrada fisica cableada con SAFETY IN=INx.</p>
      </div>
    </div>
  </div>

  <div class="panel" id="api">
    <h2>5) API local y cloud</h2>
    <div class="table">
      <div class="block">
        <h3>API local</h3>
        <pre class="code">GET  /api/v1/config
POST /api/v1/config
POST /api/v1/control
GET  /api/v1/state</pre>
        <pre class="code">POST /api/v1/control
{
  "pulseVirtualInput": "VIN1"
}</pre>
      </div>
      <div class="block">
        <h3>Cloud desiredState recomendado</h3>
        <pre class="code">{
  "desiredState": {
    "pulseVirtualInput": "VIN1"
  }
}</pre>
        <pre class="code">{
  "desiredState": {
    "workMode": 4,
    "customProgram": "PROGRAM NAME=TEST\nSTART VIN=VIN1\nSTEP REL=REL1 STATE=ON TIME=1000\nEND"
  }
}</pre>
      </div>
    </div>
  </div>

  <div class="panel" id="state">
    <h2>6) Estado parser/secuencia en /api/v1/state</h2>
    <pre class="code">customProgramValid
customProgramRuleCount
customProgramError
customProgramMode
sequenceValid
sequenceRunning
sequenceName
sequenceState
sequenceCurrentStep
sequenceCurrentLoop
sequenceError
sequenceErrorLine
sequenceLastTemp
virtualInputs
sequenceUsedRelays
sequenceReservedRelays</pre>
    <p class="muted">Tambien se reporta hacia cloud en reportedState cuando el bridge IoT esta activo.</p>
  </div>

  <div class="panel" id="examples">
    <h2>7) Ejemplos listos para copiar</h2>
    <div class="table">
      <div class="block">
        <h3>A) ONBOOT escalonado</h3>
        <pre class="code">ONBOOT REL1 10000 2000
ONBOOT REL2 12000 2000
ONBOOT REL3 14000 2000</pre>
      </div>
      <div class="block">
        <h3>B) Secuencia minima con STEP visual</h3>
        <pre class="code">PROGRAM NAME=TEST
START VIN=VIN1
STEP REL=REL1 STATE=ON TIME=5000
STEP REL=REL1 STATE=OFF
END</pre>
      </div>
      <div class="block">
        <h3>C) Enfriamiento de marmita por fases</h3>
        <pre class="code">PROGRAM NAME=MARMITA_COOL
START IN=IN1

SET REL=REL1 STATE=OFF
SET REL=REL2 STATE=OFF
SET REL=REL3 STATE=OFF
SET REL=REL4 STATE=OFF

LOOP MAX=8 UNTIL=TEMP1&lt;=40.0 STABLE=30000
STEP REL=REL1 STATE=ON TIME=30000
STEP REL=REL2 STATE=ON TIME=45000
WAIT TIME=300000
ENDLOOP

STEP REL=REL3 STATE=ON
STEP REL=REL4 STATE=ON
WAITUNTIL TEMP=TEMP1 OP=&lt;= VALUE=10.0 STABLE=60000 MAX=3600000
STEP REL=REL3 STATE=OFF
STEP REL=REL4 STATE=OFF

SAFETY IN=IN4 ACTION=ALL_OFF
END</pre>
      </div>
    </div>
  </div>
</div>
</body>
</html>
)rawliteral";


void sendJsonStatus(int code, bool ok, const String& message) {
  StaticJsonDocument<256> doc;
  doc["ok"] = ok;
  doc["message"] = message;
  String out;
  serializeJson(doc, out);
  server.sendHeader("Cache-Control", "no-store");
  server.send(code, "application/json", out);
}

bool setupAccessAllowed() {
  return !hasStoredConfig() || runtimeData.apModeActive || !config().wifiSsid[0];
}

String buildNetworkJson() {
  StaticJsonDocument<1024> doc;
  doc["hostName"] = config().hostName;
  doc["adminUser"] = config().adminUser;
  doc["adminPass"] = config().adminPass;
  doc["wifiSsid"] = config().wifiSsid;
  doc["wifiPass"] = config().wifiPass;
  doc["apPassword"] = config().apPassword;
  doc["otaPassword"] = config().otaPassword;
  doc["wifiUseDhcp"] = config().wifiUseDhcp;
  doc["wifiStaticIp"] = config().wifiStaticIp;
  doc["wifiSubnetMask"] = config().wifiSubnetMask;
  doc["wifiGateway"] = config().wifiGateway;
  doc["wifiDns1"] = config().wifiDns1;
  doc["wifiDns2"] = config().wifiDns2;
  doc["wifiConnectTimeoutSec"] = config().wifiConnectTimeoutSec;
  doc["keepApEnabled"] = config().keepApEnabled;
  doc["enableOta"] = config().enableOta;
  doc["wifiConnected"] = runtimeData.wifiConnected;
  doc["apModeActive"] = runtimeData.apModeActive;
  doc["ipAddress"] = runtimeData.ipAddress;
  doc["connectedSsid"] = runtimeData.connectedSsid;
  doc["apSsid"] = runtimeData.apSsid;
  String out;
  serializeJson(doc, out);
  return out;
}

String buildWifiScanJson() {
  StaticJsonDocument<2048> doc;
  JsonArray networks = doc.createNestedArray("networks");
  const int found = WiFi.scanNetworks();
  for (int index = 0; index < found && index < 20; ++index) {
    JsonObject row = networks.createNestedObject();
    row["ssid"] = WiFi.SSID(index);
    row["rssi"] = WiFi.RSSI(index);
  }
  WiFi.scanDelete();
  String out;
  serializeJson(doc, out);
  return out;
}

class StringPrint : public Print {
 public:
  size_t write(uint8_t ch) override {
    buffer += static_cast<char>(ch);
    return 1;
  }

  size_t write(const uint8_t* data, size_t size) override {
    if (!data || !size) return 0;
    for (size_t index = 0; index < size; ++index) {
      buffer += static_cast<char>(data[index]);
    }
    return size;
  }

  String buffer;
};

#if defined(ARDUINO_ARCH_ESP32)
size_t countOtaAppPartitions() {
  size_t count = 0;
  for (esp_partition_iterator_t it = esp_partition_find(ESP_PARTITION_TYPE_APP, ESP_PARTITION_SUBTYPE_ANY, nullptr); it != nullptr; it = esp_partition_next(it)) {
    const esp_partition_t* partition = esp_partition_get(it);
    if (!partition) continue;
    if (partition->subtype >= ESP_PARTITION_SUBTYPE_APP_OTA_0 && partition->subtype < ESP_PARTITION_SUBTYPE_APP_OTA_MAX) ++count;
  }
  return count;
}

String httpOtaPreflightError(size_t firmwareSize) {
  const size_t otaPartitionCount = countOtaAppPartitions();
  if (otaPartitionCount < 2) {
    return "OTA unavailable: no free OTA slot. Flash by USB.";
  }
  const esp_partition_t* running = esp_ota_get_running_partition();
  const esp_partition_t* target = esp_ota_get_next_update_partition(nullptr);
  if (!target || (running && target->address == running->address)) {
    return "OTA unavailable: target slot error. Flash by USB.";
  }
  if (firmwareSize && firmwareSize > target->size) {
    String message = "OTA image too large for slot: ";
    message += static_cast<unsigned long>(firmwareSize);
    message += " > ";
    message += static_cast<unsigned long>(target->size);
    message += " bytes.";
    return message;
  }
  return String();
}
#else
String httpOtaPreflightError(size_t firmwareSize) {
  (void)firmwareSize;
  return String();
}
#endif

void clearHttpOtaState() {
  gHttpOtaStarted = false;
  gHttpOtaErrorMessage = String();
}

String otaUploadResultText() {
  if (gHttpOtaErrorMessage.length()) return gHttpOtaErrorMessage;
  StringPrint errors;
  Update.printError(errors);
  String message = errors.buffer;
  message.trim();
  if (!message.length()) message = "OTA upload failed";
  return message;
}

void sendCompressedHtml(const uint8_t* data, size_t length) {
  server.sendHeader("Content-Encoding", "gzip");
  server.send_P(200, "text/html", reinterpret_cast<PGM_P>(data), length);
}

bool sendHtmlFromFilesystem(const char* htmlPath) {
  if (!htmlPath || !htmlPath[0]) return false;

  File htmlFile = APP_FILESYSTEM.open(htmlPath, "r");
  if (htmlFile) {
    const size_t htmlSize = static_cast<size_t>(htmlFile.size());
    if (htmlSize < 32U) {
      htmlFile.close();
      return false;
    }
    server.streamFile(htmlFile, "text/html");
    htmlFile.close();
    return true;
  }

  const String gzPath = String(htmlPath) + String(".gz");
  File gzFile = APP_FILESYSTEM.open(gzPath, "r");
  if (!gzFile) return false;
  const size_t gzSize = static_cast<size_t>(gzFile.size());
  if (gzSize < 32U) {
    gzFile.close();
    return false;
  }

  server.sendHeader("Content-Encoding", "gzip");
  server.streamFile(gzFile, "text/html");
  gzFile.close();
  return true;
}

}  // namespace

void registerWebRoutes() {
  server.on("/", HTTP_GET, []() {
    server.sendHeader("Cache-Control", "no-store");
    server.sendHeader("Location", setupAccessAllowed() ? "/setup" : "/app");
    server.send(302, "text/plain", "redirect");
  });

  server.on("/setup", HTTP_GET, []() {
    if (!setupAccessAllowed() && !ensureAdminAuthenticated()) return;
    server.sendHeader("Cache-Control", "no-store");
    if (!sendHtmlFromFilesystem(kFsSetupHtmlPath)) {
      sendCompressedHtml(SETUP_HTML_GZ, SETUP_HTML_GZ_LEN);
    }
  });

  server.on("/app", HTTP_GET, []() {
    if (!ensureAdminAuthenticated()) return;
    server.sendHeader("Cache-Control", "no-store");
    if (server.hasArg("page")) {
      const String page = server.arg("page");
      if (page == "modbus-map") {
        server.sendHeader("Location", "/app?page=modbus");
        server.send(302, "text/plain", "redirect");
        return;
      }
      if (page == "custom-program") {
        if (!sendHtmlFromFilesystem(kFsCustomProgramHtmlPath)) {
          server.send_P(200, "text/html", reinterpret_cast<PGM_P>(CUSTOM_PROGRAM_HTML));
        }
        return;
      }
      if (page == "custom-program-guide") {
        if (!sendHtmlFromFilesystem(kFsCustomProgramGuideHtmlPath)) {
          server.send_P(200, "text/html", reinterpret_cast<PGM_P>(CUSTOM_PROGRAM_GUIDE_HTML));
        }
        return;
      }
    }
    if (!sendHtmlFromFilesystem(kFsAppHtmlPath)) {
      sendCompressedHtml(APP_HTML_GZ, APP_HTML_GZ_LEN);
    }
  });

  server.on("/modbus-map", HTTP_GET, []() {
    if (!ensureAdminAuthenticated()) return;
    server.sendHeader("Cache-Control", "no-store");
    server.sendHeader("Location", "/app?page=modbus");
    server.send(302, "text/plain", "redirect");
  });

  server.on("/custom-program", HTTP_GET, []() {
    if (!ensureAdminAuthenticated()) return;
    server.sendHeader("Cache-Control", "no-store");
    if (!sendHtmlFromFilesystem(kFsCustomProgramHtmlPath)) {
      server.send_P(200, "text/html", reinterpret_cast<PGM_P>(CUSTOM_PROGRAM_HTML));
    }
  });

  server.on("/custom-program-guide", HTTP_GET, []() {
    if (!ensureAdminAuthenticated()) return;
    server.sendHeader("Cache-Control", "no-store");
    if (!sendHtmlFromFilesystem(kFsCustomProgramGuideHtmlPath)) {
      server.send_P(200, "text/html", reinterpret_cast<PGM_P>(CUSTOM_PROGRAM_GUIDE_HTML));
    }
  });

  server.on("/ota", HTTP_GET, []() {
    if (!ensureAdminAuthenticated()) return;
    server.sendHeader("Cache-Control", "no-store");
    if (!sendHtmlFromFilesystem(kFsOtaHtmlPath)) {
      sendCompressedHtml(OTA_HTML_GZ, OTA_HTML_GZ_LEN);
    }
  });

  server.on("/api/v1/network", HTTP_GET, []() {
    if (!setupAccessAllowed() && !ensureAdminAuthenticated()) return;
    server.sendHeader("Cache-Control", "no-store");
    server.send(200, "application/json", buildNetworkJson());
  });

  server.on("/api/v1/network", HTTP_POST, []() {
    if (!setupAccessAllowed() && !ensureAdminAuthenticated()) return;
    String error;
    if (updateConfigFromJson(server.arg("plain"), error)) sendJsonStatus(200, true, "network saved");
    else sendJsonStatus(400, false, error);
  });

  server.on("/api/v1/wifi-scan", HTTP_GET, []() {
    if (!setupAccessAllowed() && !ensureAdminAuthenticated()) return;
    server.sendHeader("Cache-Control", "no-store");
    server.send(200, "application/json", buildWifiScanJson());
  });

  server.on("/api/v1/ota", HTTP_POST, []() {
    if (!ensureAdminAuthenticated()) return;
    const bool success = gHttpOtaStarted && !Update.hasError() && !gHttpOtaErrorMessage.length();
    const String message = success ? String("OTA uploaded successfully. Reboot scheduled.") : otaUploadResultText();
    server.sendHeader("Cache-Control", "no-store");
    server.send(success ? 200 : 500, "text/plain", message);
    if (success) {
      addLog("HTTP OTA upload completed successfully");
      scheduleRestart("http ota", 1500U);
    } else {
      addLog("HTTP OTA upload failed: %s", message.c_str());
    }
    clearHttpOtaState();
  }, []() {
    HTTPUpload& upload = server.upload();
    switch (upload.status) {
      case UPLOAD_FILE_START:
        clearHttpOtaState();
        addLog("HTTP OTA upload started: %s", upload.filename.c_str());
        gHttpOtaErrorMessage = httpOtaPreflightError(upload.totalSize);
        if (gHttpOtaErrorMessage.length()) {
          addLog("HTTP OTA upload rejected: %s", gHttpOtaErrorMessage.c_str());
          break;
        }
        if (!Update.begin(upload.totalSize ? upload.totalSize : UPDATE_SIZE_UNKNOWN, U_FLASH)) {
          Update.printError(Serial);
          gHttpOtaErrorMessage = otaUploadResultText();
          addLog("HTTP OTA begin failed: %s", gHttpOtaErrorMessage.c_str());
        } else {
          gHttpOtaStarted = true;
        }
        break;
      case UPLOAD_FILE_WRITE:
        if (!gHttpOtaStarted) break;
        if (Update.write(upload.buf, upload.currentSize) != upload.currentSize) {
          Update.printError(Serial);
          gHttpOtaErrorMessage = otaUploadResultText();
          addLog("HTTP OTA write failed: %s", gHttpOtaErrorMessage.c_str());
        }
        break;
      case UPLOAD_FILE_END:
        if (!gHttpOtaStarted) break;
        if (!Update.end(true)) {
          Update.printError(Serial);
          gHttpOtaErrorMessage = otaUploadResultText();
          addLog("HTTP OTA end failed: %s", gHttpOtaErrorMessage.c_str());
        }
        break;
      case UPLOAD_FILE_ABORTED:
        if (gHttpOtaStarted) Update.abort();
        gHttpOtaErrorMessage = "OTA upload aborted";
        addLog("HTTP OTA upload aborted");
        break;
      default:
        break;
    }
    yield();
  });

  server.on("/api/v1/state", HTTP_GET, []() {
    if (!ensureAdminAuthenticated()) return;
    server.sendHeader("Cache-Control", "no-store");
    server.send(200, "application/json", buildStateJson());
  });

  server.on("/api/v1/logs", HTTP_GET, []() {
    if (!ensureAdminAuthenticated()) return;
    server.sendHeader("Cache-Control", "no-store");
    server.send(200, "text/plain", buildLogsText());
  });

  server.on("/api/v1/config", HTTP_GET, []() {
    if (!ensureAdminAuthenticated()) return;
    server.sendHeader("Cache-Control", "no-store");
    server.send(200, "application/json", buildConfigJson());
  });

  server.on("/api/v1/config", HTTP_POST, []() {
    if (!ensureAdminAuthenticated()) return;
    String error;
    if (updateConfigFromJson(server.arg("plain"), error)) sendJsonStatus(200, true, "configuration saved");
    else sendJsonStatus(400, false, error);
  });

  server.on("/api/v1/control", HTTP_POST, []() {
    if (!ensureAdminAuthenticated()) return;
    String error;
    if (handleControlJson(server.arg("plain"), error)) sendJsonStatus(200, true, "control applied");
    else sendJsonStatus(400, false, error);
  });

  server.on("/api/v1/reboot", HTTP_POST, []() {
    if (!ensureAdminAuthenticated()) return;
    scheduleRestart("api reboot", 1000U);
    sendJsonStatus(200, true, "reboot scheduled");
  });

  server.on("/api/v1/factory-reset", HTTP_POST, []() {
    if (!ensureAdminAuthenticated()) return;
    factoryResetAndRestart();
    sendJsonStatus(200, true, "factory reset scheduled");
  });

  server.onNotFound([]() {
    server.sendHeader("Location", setupAccessAllowed() ? "/setup" : "/app");
    server.send(302, "text/plain", "redirect");
  });
}

}  // namespace industrial_v2







